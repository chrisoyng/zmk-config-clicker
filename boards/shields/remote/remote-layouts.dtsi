#include <physical_layouts.dtsi>

/ {
    physical_layout0: physical_layout0 {
        compatible = "zmk,physical-layout";
        display-name = "2-Key Macropad";
        transform = <&default_transform>;
        kscan = <&kscan0>;
        keys  //          w   h    x    y   rot rx ry
            = <&key_physical_attrs 100 100   0    0    0  0  0>
            , <&key_physical_attrs 100 100 100    0    0  0  0>
            ;
    };
};
